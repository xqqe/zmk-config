## config/boards/shields/dilbert/Kconfig.defconfig
```kconfig
if SHIELD_DILBERT

config ZMK_KEYBOARD_NAME
    default "dilbert"

endif

if ZMK_DISPLAY

config I2C
  default y

config SSD1306
  default y

config SSD1306_REVERSE_MODE
  default y

config ZMK_DISPLAY_BLANK_ON_IDLE
  default y

endif # ZMK_DISPLAY
```

## config/boards/shields/skai/Kconfig.defconfig
```kconfig
if SHIELD_SKAI
    config ZMK_KEYBOARD_NAME
        default "SKAI Macroboard"
endif
```
